/*
  Project: Scrolling message on LED dot matrix display
  MCU: PIC16F1847 @ 16.0 MHz
  Copyright @ Rajendra Bhatt
  Apr 14, 2012
*/

// Define 74HC595 connections.

 sbit Serial_Data at RA0_bit;
 sbit SH_Clk at RA1_bit;
 sbit ST_Clk at RA2_bit;

 unsigned short Buffer[8][5] = {
                              {0,0,0,0,0},
                              {0,0,0,0,0},
                              {0,0,0,0,0},
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                              {0,0,0,0,0}
                             };

unsigned int speed, StringLength;
unsigned short i, l, k, row, scroll, temp, shift_step=1;
unsigned short m, SerialConnect=0, UserIP = 0;

const unsigned char default_message[]="THIS IS A DEMONSTRATION OF AN 8X40 LED MATRIX DISPLAY USING \
SHIFT REGISTERS AND PIC16F1847 MICROCONTROLLER. FOR MORE DETAILS VISIT \
WWW.EMBEDDED-LAB.COM.    ";

char message[250], index;

void Send_Data(unsigned short rw){
 unsigned short Mask, t, num, Flag;
 for (num = 0; num < 5; num++) {
  Mask = 0x01;
  for (t=0; t<8; t++){
   Flag = Buffer[rw][num] & Mask;
   if(Flag==0) Serial_Data = 0;
   else Serial_Data = 1;
   SH_Clk = 1;
   SH_Clk = 0;
   Mask = Mask << 1;
  }
  }

  // Apply clock on ST_Clk
  ST_Clk = 1;
  ST_Clk = 0;

}

/* CharData is a two dimensional constant array that holds the 8-bit column values of
   individual rows for ASCII characters on a 8x8 matrix format.
*/
const unsigned short CharData[][8] ={
{0b00000000, 0b00000000, 0b00000000, 0b00000000, 0b00000000, 0b00000000, 0b00000000, 0b00000000},
{0b00000100, 0b00000100, 0b00000100, 0b00000100, 0b00000100, 0b00000100, 0b00000000, 0b00000100},
{0b00001010, 0b00001010, 0b00001010, 0b00000000, 0b00000000, 0b00000000, 0b00000000, 0b00000000},
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{0b00000000, 0b00000000, 0b00000000, 0b00001010, 0b00011110, 0b00010100, 0b00000000, 0b00000000}
};

void Delay_onesec(){
  Delay_ms(1000);
}
unsigned short Find_StrLength(){
  return strlen(message);
}

void Save_Message(){
  EEPROM_Write(0x00, 1);
  EEPROM_Write(0x01, StringLength);
  for(i=0; i<StringLength; i++){
    EEPROM_Write(i+2, message[i]);
  }
  EEPROM_Write(i+2, 32);
  EEPROM_Write(i+3, 32);
  EEPROM_Write(i+4, 32);
  EEPROM_Write(i+5, 32);
  UART1_Write(13); // Carriage Return
  UART1_Write(10); // Line Feed
  UART_Write_Text("MESSAGE SAVED!");
}

void ListenSerial(){
  unsigned char RxByte;
  UART_Write_Text("---- 8X40 LED Matrix Display ----");
  UART1_Write(13); // Carriage Return
  UART1_Write(10); // Line Feed
  UART_Write_Text("ARE YOU READY FOR YOUR INPUT? Y/N");
  Delay_onesec();
  Delay_onesec();
  Delay_onesec();
  if (UART1_Data_Ready()) {
    RxByte = UART1_Read();
    if(RxByte == 'Y') {
      UART1_Write(13); // Carriage Return
      UART1_Write(10); // Line Feed
      UART_Write_Text("Great! Always terminate your message with #");
      UART1_Write(13); // Carriage Return
      UART1_Write(10); // Line Feed
      UART_Write_Text("Waiting for your input (MAX. 250 char.) ...");
      while (!UART_Data_Ready());          // if data is received
      UART_Read_Text(message, "#", 250);    // reads text until '#' is found
      message[0] = ' ';
      StringLength = Find_StrLength();
      UART1_Write(13); // Carriage Return
      UART1_Write(10); // Line Feed
      UART_Write_Text("Message received. Now saving into EEPROM ...");
      Save_Message();
    }
  }
}

// Subroutine to load the stored message onto RAM
void Load_Data(){
 for (k=0; k<StringLength+4; k++){
  message[k] = EEPROM_Read(k+2);
 }
}

void main() {
 OSCCON = 0b01110000;  // 32 MHz internal
 ANSELA = 0b00000000;  // PORTA all digital pins
 ANSELB = 0b00000000;  // PORTB all digital pins
 TRISA  = 0b00100000;  // RA5 is input only
 TRISB  = 0b00000010;  // RB1 is UART Rx
 PORTB  = 0;
 UART1_Init(115200);
 Delay_ms(100);
 ListenSerial();       // Check for serial data receive
 TRISB  = 0b00000000;  // PORTB is now all output
 RCSTA  = 0x00;
 // Read first two EEPROM locations
 UserIP = EEPROM_Read(0x00);
 
 if(UserIP == 1) {
   StringLength = EEPROM_Read(0x01);
   Load_Data();  // Read stored data and save into RAM
 }
 else  StringLength = 156;

 do {
 for (k=0; k<StringLength+4; k++){
  for (scroll=0; scroll<(8/shift_step); scroll++) {
   for (row=0; row<8; row++){
     if(UserIP == 1) index = message[k];
     else index = default_message[k];
     temp = CharData[index-32][row];
     Buffer[row][4] = (Buffer[row][4] << Shift_Step) | (Buffer[row][3] >> (8-Shift_Step));
     Buffer[row][3] = (Buffer[row][3] << Shift_Step) | (Buffer[row][2] >> (8-Shift_Step));
     Buffer[row][2] = (Buffer[row][2] << Shift_Step) | (Buffer[row][1] >> (8-Shift_Step));
     Buffer[row][1] = (Buffer[row][1] << Shift_Step) | (Buffer[row][0] >> (8-Shift_Step));
     Buffer[row][0] = (Buffer[row][0] << Shift_Step)| (temp >> ((8-shift_step)-scroll*shift_step));
   }
   speed = 15;
   for(l=0; l<speed;l++){
     m = 1;
     for (i=0; i<8; i++) {
       Send_Data(i);
       LATB = m;
       m = m << 1;
       Delay_us(1000);
     }  // i
   } // l
  } // scroll
 } // k

} while(1);
}